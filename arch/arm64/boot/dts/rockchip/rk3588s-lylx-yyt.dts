// SPDX-License-Identifier: (GPL-2.0+ OR MIT)
/*
 * Copyright (c) 2021 Rockchip Electronics Co., Ltd.
 *
 */

/dts-v1/;

#include "rk3588s-lylx-yyt.dtsi"
#include "rk3588-android.dtsi"

/ {
	model = "Rockchip RK3588S LYLX YYT Board";
	compatible = "rockchip,rk3588s-lylx-yyt", "rockchip,rk3588";
};
